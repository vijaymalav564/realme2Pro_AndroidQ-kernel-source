## drivers/soc/oppo/oppo_criticallog/Kconfig
```kconfig
#ifdef CONFIG_PRODUCT_REALME_RMX1801
#//John.Xu@PhoneSw.AudioDriver, 2016/02/22, Add for critical_log
config OPPO_CRITICALLOG
bool "config oppo critical log"
help
    define this config to init oppo critical log driver.
#endif /* CONFIG_PRODUCT_REALME_RMX1801 */
```

## drivers/soc/oppo/oppo_healthinfo/Kconfig
```kconfig
#ifdef CONFIG_VENDOR_REALME
#//wenbin.liu@PSW.Kernel.MM, 2018/05/23, Add for Healthinfo monitor
config OPPO_HEALTHINFO
bool "config oppo healthinfo"
help
    define this config to init oppo healthinfo.
#endif /* CONFIG_VENDOR_REALME */
```

## drivers/soc/oppo/oppo_shutdown_detect/Kconfig
```kconfig
#ifdef CONFIG_VENDOR_REALME
#Wen.Luo@PSW.Kernel.Stability, 2018/05/23, Add for oppo_shutdown_detect monitor
config OPPO_SHUTDOWN_DETECT
	bool "OPPO shutdown hang detect"
	default y
	help
	  define this config to init oppo oppo_shutdown_detect.
#endif /* CONFIG_VENDOR_REALME */
```

## kernel/Kconfig.freezer
```kconfig
config FREEZER
	def_bool PM_SLEEP || CGROUP_FREEZER

#ifdef CONFIG_PRODUCT_REALME_RMX1801
#zhoumingjun@Swdp.shanghai, 20117/07/13, add config for elsa stubs
config ELSA_STUB
	bool "Enable ELSA stub in kernel"
	default n
#endif
```
